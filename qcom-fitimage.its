## qcom-fitimage.its
```
/dts-v1/;

/ {
	description = "Qualcomm FIT Image for DTBs";
	#address-cells = <1>;

	images {
		fdt-0 {
			description = "metadata for multi-DTB selection";
			data = /incbin/("./qcom-metadata.dtb");
			type = "qcom_metadata";
		};
		fdt-1 {
			data = /incbin/("./arch/arm64/boot/dts/qcom/qcm6490-idp.dtb");
			type = "flat_dt";
		};
		fdt-2 {
			data = /incbin/("./arch/arm64/boot/dts/qcom/qcs6490-rb3gen2.dtb");
			type = "flat_dt";
		};
		fdt-3 {
			data = /incbin/("./arch/arm64/boot/dts/qcom/qcs6490-rb3gen2-vision-mezzanine.dtb");
			type = "flat_dt";
		};
		fdt-4 {
			data = /incbin/("./arch/arm64/boot/dts/qcom/qcs6490-rb3gen2-industrial-mezzanine.dtb");
			type = "flat_dt";
		};
		fdt-5 {
			data = /incbin/("./arch/arm64/boot/dts/qcom/lemans-evk.dtb");
			type = "flat_dt";
		};
		fdt-6 {
			data = /incbin/("./arch/arm64/boot/dts/qcom/qcs9100-ride.dtb");
			type = "flat_dt";
		};
		fdt-7 {
			data = /incbin/("./arch/arm64/boot/dts/qcom/qcs8300-ride.dtb");
			type = "flat_dt";
		};
		fdt-8 {
			data = /incbin/("./arch/arm64/boot/dts/qcom/monaco-evk.dtb");
			type = "flat_dt";
		};
		fdt-9 {
			data = /incbin/("./arch/arm64/boot/dts/qcom/qcs615-ride.dtb");
			type = "flat_dt";
		};
	};

	configurations {
		conf-1 {
			compatible = "qcom,qcm6490-idp";
			fdt = "fdt-1";
		};
		conf-2 {
			compatible = "qcom,qcs6490-iot";
			fdt = "fdt-2";
		};
		conf-3 {
			compatible = "qcom,qcs6490-iot-subtype2";
			fdt = "fdt-3";
		};
		conf-4 {
			compatible = "qcom,qcs6490r3-iot-subtype2";
			fdt = "fdt-3";
		};
		conf-5 {
			compatible = "qcom,qcs6490-iot-subtype9";
			fdt = "fdt-4";
		};
		conf-6 {
			compatible = "qcom,qcs9075-iot";
			fdt = "fdt-5";
		};
		conf-7 {
			compatible = "qcom,qcs9100-adp";
			fdt = "fdt-6";
		};
		conf-8 {
			compatible = "qcom,qcs8300-adp";
			fdt = "fdt-7";
		};
		conf-9 {
			compatible = "qcom,qcs8275-iot";
			fdt = "fdt-8";
		};
		conf-10 {
			compatible = "qcom,qcs615-adp";
			fdt = "fdt-9";
		};
	};
};
```
